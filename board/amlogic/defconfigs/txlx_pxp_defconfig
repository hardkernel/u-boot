## board/amlogic/defconfigs/txlx_pxp_defconfig
```kconfig
CONFIG_ARM=y
CONFIG_TARGET_MESON_TXLX=y
CONFIG_TXLX_T962X_SKT_V1=y
CONFIG_DM=y
CONFIG_DM_GPIO=y
CONFIG_AML_GPIO=y
CONFIG_PXP_EMULATOR=y
```

## board/amlogic/defconfigs/txlx_t962e_r321_v1_defconfig
```kconfig
CONFIG_ARM=y
CONFIG_TARGET_MESON_TXLX=y
CONFIG_TXLX_T962E_R321_V1=y
CONFIG_DM=y
CONFIG_DM_GPIO=y
CONFIG_AML_GPIO=y
```

## board/amlogic/g12a_skt_v1/Kconfig
```kconfig
if TARGET_MESON_g12a

config SYS_CPU
	string
	default "armv8"

config SYS_BOARD
	string
	default "g12a_skt_v1"

config SYS_VENDOR
	string
	default "amlogic"

config SYS_SOC
	string
	default "g12a"

config SYS_CONFIG_NAME
	default "g12a_skt_v1"

endif
```

## board/amlogic/g12b_w400_v1/Kconfig
```kconfig
if TARGET_MESON_G12B

config SYS_CPU
	string
	default "armv8"

config SYS_BOARD
	string
	default "g12b_w400_v1"

config SYS_VENDOR
	string
	default "amlogic"

config SYS_SOC
	string
	default "g12b"

config SYS_CONFIG_NAME
	default "g12b_w400_v1"

endif
```

## board/amlogic/gx_skt_v1/Kconfig
```kconfig
if TARGET_MESON_GX

config SYS_CPU
	string
	default "armv8"

config SYS_BOARD
	string
	default "gx_skt_v1"

config SYS_VENDOR
	string
	default "amlogic"

config SYS_SOC
	string
	default "gx"

config SYS_CONFIG_NAME
	default "gx_skt_v1"

endif
```

## board/amlogic/gxb_p200_v1/Kconfig
```kconfig
if TARGET_MESON_GX

config SYS_CPU
	string
	default "armv8"

config SYS_BOARD
	string
	default "gxb_p200_v1"

config SYS_VENDOR
	string
	default "amlogic"

config SYS_SOC
	string
	default "gxb"

config SYS_CONFIG_NAME
	default "gxb_p200_v1"

endif
```

## board/amlogic/gxl_q200_v1/Kconfig
```kconfig
if TARGET_MESON_GX

config SYS_CPU
	string
	default "armv8"

config SYS_BOARD
	string
	default "gxl_q200_v1"

config SYS_VENDOR
	string
	default "amlogic"

config SYS_SOC
	string
	default "gxl"

config SYS_CONFIG_NAME
	default "gxl_q200_v1"

endif
```

## board/amlogic/gxm_q201_v1/Kconfig
```kconfig
if TARGET_MESON_GX

config SYS_CPU
	string
	default "armv8"

config SYS_BOARD
	string
	default "gxm_q201_v1"

config SYS_VENDOR
	string
	default "amlogic"

config SYS_SOC
	string
	default "gxl"

config SYS_CONFIG_NAME
	default "gxm_q201_v1"

endif
```

## board/amlogic/gxtvbb_p300_v1/Kconfig
```kconfig
if TARGET_MESON_GXTV

config SYS_CPU
	string
	default "armv8"

config SYS_BOARD
	string
	default "gxtvbb_p300_v1"

config SYS_VENDOR
	string
	default "amlogic"

config SYS_SOC
	string
	default "gxtvbb"

config SYS_CONFIG_NAME
	default "gxtvbb_p300_v1"

endif
```

## board/amlogic/sm1_ac213_v1/Kconfig
```kconfig
if TARGET_MESON_G12A

config SYS_CPU
	string
	default "armv8"

config SYS_BOARD
	string
	default "g12a_u212_v1"

config SYS_VENDOR
	string
	default "amlogic"

config SYS_SOC
	string
	default "g12a"

config SYS_CONFIG_NAME
	default "sm1_ac213_v1"

endif
```

## board/amlogic/sm1_skt_v1/Kconfig
```kconfig
if TARGET_MESON_G12A

config SYS_CPU
	string
	default "armv8"

config SYS_BOARD
	string
	default "g12a_skt_v1"

config SYS_VENDOR
	string
	default "amlogic"

config SYS_SOC
	string
	default "g12a"

config SYS_CONFIG_NAME
	default "sm1_skt_v1"

endif
```

## board/amlogic/tl1_x301_v1/Kconfig
```kconfig
if TARGET_MESON_TL1

config SYS_CPU
	string
	default "armv8"

config SYS_BOARD
	string
	default "tl1_x301_v1"

config SYS_VENDOR
	string
	default "amlogic"

config SYS_SOC
	string
	default "tl1"

config SYS_CONFIG_NAME
	default "tl1_x301_v1"

endif
```

## board/amlogic/tm2_t962e2_ab311_v1/Kconfig
```kconfig
if TARGET_MESON_TM2

config SYS_CPU
	string
	default "armv8"

config SYS_BOARD
	string
	default "tm2_t962e2_ab311_v1"

config SYS_VENDOR
	string
	default "amlogic"

config SYS_SOC
	string
	default "tm2"

config SYS_CONFIG_NAME
	default "tm2_t962e2_ab311_v1"

config MTK_BT_USB
    bool "enable mtk bt usb function"
    default n
    help
        select this item will enable mtk bt usb device

endif
```

## board/amlogic/tm2_t962e2_ab319_v1/Kconfig
```kconfig
if TARGET_MESON_TM2

config SYS_CPU
	string
	default "armv8"

config SYS_BOARD
	string
	default "tm2_t962e2_ab319_v1"

config SYS_VENDOR
	string
	default "amlogic"

config SYS_SOC
	string
	default "tm2"

config SYS_CONFIG_NAME
	default "tm2_t962e2_ab319_v1"

endif
```

## board/amlogic/txhd_r341_v1/Kconfig
```kconfig
if TARGET_MESON_TXHD

config SYS_CPU
	string
	default "armv8"

config SYS_BOARD
	string
	default "txhd_r341_v1"

config SYS_VENDOR
	string
	default "amlogic"

config SYS_SOC
	string
	default "txhd"

config SYS_CONFIG_NAME
	default "txhd_r341_v1"

endif
```

## board/amlogic/txhd_skt_v1/Kconfig
```kconfig
if TARGET_MESON_TXLX

config SYS_CPU
	string
	default "armv8"

config SYS_BOARD
	string
	default "txhd_skt_v1"

config SYS_VENDOR
	string
	default "amlogic"

config SYS_SOC
	string
	default "txlx"

config SYS_CONFIG_NAME
	default "txhd_skt_v1"

endif
```

## board/amlogic/txl_p321_v1/Kconfig
```kconfig
if TARGET_MESON_GXTV

config SYS_CPU
	string
	default "armv8"

config SYS_BOARD
	string
	default "txl_p321_v1"

config SYS_VENDOR
	string
	default "amlogic"

config SYS_SOC
	string
	default "txl"

config SYS_CONFIG_NAME
	default "txl_p321_v1"

endif
```

## board/amlogic/txl_p341_v1/Kconfig
```kconfig
if TARGET_MESON_TXL

config SYS_CPU
	string
	default "armv8"

config SYS_BOARD
	string
	default "txl_p341_v1"

config SYS_VENDOR
	string
	default "amlogic"

config SYS_SOC
	string
	default "txl"

config SYS_CONFIG_NAME
	default "txl_p341_v1"

endif
```

## board/amlogic/txl_skt_v1/Kconfig
```kconfig
if TARGET_MESON_GX

config SYS_CPU
	string
	default "armv8"

config SYS_BOARD
	string
	default "txl_skt_v1"

config SYS_VENDOR
	string
	default "amlogic"

config SYS_SOC
	string
	default "txl"

config SYS_CONFIG_NAME
	default "txl_skt_v1"

endif
```

## board/amlogic/txlx_t962x_skt_v1/Kconfig
```kconfig
if TARGET_MESON_TXLX

config SYS_CPU
	string
	default "armv8"

config SYS_BOARD
	string
	default "txlx_t962x_skt_v1"

config SYS_VENDOR
	string
	default "amlogic"

config SYS_SOC
	string
	default "txlx"

config SYS_CONFIG_NAME
	default "txlx_t962x_skt_v1"

endif
```

## board/hardkernel/Kconfig
```kconfig
config ODROID_C2
	bool "Support Hardkernel ODROID-C2 board"
	default n

if ODROID_C2
source "board/hardkernel/odroidc2/Kconfig"
endif
```

## board/hardkernel/odroid-c2/Kconfig
```kconfig
if TARGET_MESON_GX

config SYS_CPU
	string
	default "armv8"

config SYS_BOARD
	string
	default "odroid-c2"

config SYS_VENDOR
	string
	default "hardkernel"

config SYS_SOC
	string
	default "gxb"

config SYS_CONFIG_NAME
	default "odroid-c2"

endif
```

## board/hardkernel/odroid-m1/Kconfig
```kconfig
if TARGET_ODROID_M1

config SYS_BOARD
	default "odroid-m1"

config SYS_VENDOR
	default "hardkernel"

config SYS_CONFIG_NAME
	default "odroid-m1"

config BOARD_SPECIFIC_OPTIONS # dummy
	def_bool y

endif
```

## board/hardkernel/odroid-m1s/Kconfig
```kconfig
if TARGET_ODROID_M1S

config SYS_BOARD
	default "odroid-m1s"

config SYS_VENDOR
	default "hardkernel"

config SYS_CONFIG_NAME
	default "odroid-m1s"

config BOARD_SPECIFIC_OPTIONS # dummy
	def_bool y

endif
```

## board/hardkernel/odroid-m2/Kconfig
```kconfig
if TARGET_ODROID_M2

config SYS_BOARD
	default "odroid-m2"

config SYS_VENDOR
	default "hardkernel"

config SYS_CONFIG_NAME
	default "odroid-m2"

config BOARD_SPECIFIC_OPTIONS # dummy
	def_bool y

endif
```
