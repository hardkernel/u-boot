## drivers/input/Kconfig
```kconfig
config DM_KEYBOARD
	bool "Enable driver model keyboard support"
	depends on DM
	help
	  This adds a uclass for keyboards and implements keyboard support
	  using driver model. The API is implemented by keyboard.h and
	  includes methods to start/stop the device, check for available
	  input and update LEDs if the keyboard has them.

config DM_KEY
	bool "Enable driver model key support"
	depends on DM
	help
	  This adds a simple uclass for key.

config DM_RC
	bool "Enable driver model Remote Controller support"
	depends on DM
	help
	  This adds a uclass for Remote Controllers. This is needed
	  in order to support standalone IR receivers.

config RK_IR
	bool "Enable rk ir support"
	depends on DM_RC
	select BITREVERSE
	help
	  This adds a driver for the rockchip IR controller.

config CROS_EC_KEYB
	bool "Enable Chrome OS EC keyboard support"
	help
	  Most ARM Chromebooks use an EC to provide access to the keyboard.
	  Messages are used to request key scans from the EC and these are
	  then decoded into keys by this driver.

config I8042_KEYB
	bool "Enable Intel i8042 keyboard support"
	depends on DM_KEYBOARD
	default X86
	help
	  This adds a driver for the i8042 keyboard controller, allowing the
	  keyboard to be used on devices which support this controller. The
	  driver handles English and German keyboards - set the environment
	  variable 'keymap' to "de" to select German. Keyboard repeat is
	  handled by the keyboard itself.

config RK8XX_PWRKEY
	bool "Enable RK805/816/817 pwrkey support"
	depends on DM_KEY && PMIC_RK8XX
	help
	  This adds a driver for the RK805/816/817 pwrkey support.

config ADC_KEY
	bool "Enable adc keys support"
	depends on DM_KEY
	help
	  This adds a driver for the adc keys support.

config GPIO_KEY
	bool "Enable gpio keys support"
	depends on DM_KEY
	help
	  This adds a driver for the gpio keys support.

config RK_KEY
	bool "Enable rk keys support"
	depends on DM_KEY
	help
	  This adds a driver for the rk keys support.
```

## drivers/irq/Kconfig
```kconfig
config IRQ
	bool "IRQ support"
	depends on GICV2 || GICV3
	default y
	help
	  Provide IRQ support for platforms

config IRQ2GPIO_V2
	bool "Enable irq to gpio v2 transfer"
	depends on IRQ
	help
	  Some platform with new GPIO IP implements the low/high
	  registers with write mask. This configure handles it.
```

## drivers/mtd/nand/spi/Kconfig
```kconfig
menuconfig MTD_SPI_NAND
	bool "SPI NAND device Support"
	depends on MTD && DM_SPI
	select MTD_NAND_CORE
	select SPI_MEM
	select MTD_NAND_BBT_USING_FLASH
	help
	  This is the framework for the SPI NAND device drivers.
```

## drivers/nand/Kconfig
```kconfig
config AML_NAND
	bool "AML Nand Support"
	help
	  Enable support for the Amlogic NAND controller.

config SECURE_NAND
	bool "secure nand"
	depends on AML_NAND
```

## drivers/power/charge/Kconfig
```kconfig
config CHARGER_BQ25700
	bool "BQ25700 charger support"
	depends on DM_FUEL_GAUGE
	help
	  This adds support for BQ25700 charger support.
```

## drivers/power/fuel_gauge/Kconfig
```kconfig
config DM_FUEL_GAUGE
	bool "Enable driver model fuel gauge support"
	depends on DM
	help
	  This adds a simple uclass for fuel gauge.

config POWER_FG_RK818
	bool "RK818 Fuel gauge support"
	depends on DM_FUEL_GAUGE && PMIC_RK8XX
	help
	  This adds support for RK818 fuel gauge support.
```

## drivers/ram/rockchip/Kconfig
```kconfig
config ROCKCHIP_DMC
	bool "ROCKCHIP DMC"
	help
	  This enable dram devfreq driver.

config ROCKCHIP_SDRAM_COMMON
	bool "Enable rockchip sdram common driver"
	depends on TPL_RAM || SPL_RAM
	help
	  This enable sdram common driver
```

## drivers/rkflash/Kconfig
```kconfig
#
# Copyright (c) 2018 Fuzhou Rockchip Electronics Co., Ltd
#
# SPDX-License-Identifier: (GPL-2.0+ OR MIT)
#
if ARCH_ROCKCHIP

menuconfig RKFLASH
	tristate "Rockchip Flash Devices Support"
	default n
	help
	  Enable rockchip flash devices support.
	  rkflash driver support 3-type flash devices: NANDC NAND, SFC_NOR
	  and SFC_NAND.
	  Say Y when you have a board with one of them.

if RKFLASH

comment "Rockchip Flash Devices"

config RKSFC_NOR
	bool "Rockchip SFC NOR flash support"
	depends on BLK
	help
	  This option enables support for Rockchip SFC nor devices.
	  It's block interface.
	  512Kb/sector.
	  Say y here to enable rockchip spi nor flash driver.

endif # RKFLASH

endif # ARCH_ROCKCHIP
```

## drivers/rknand/Kconfig
```kconfig
#
# Copyright (C) (C) Copyright 2016-2017 Rockchip Electronics Co., Ltd
#
# SPDX-License-Identifier:	GPL-2.0+
#

config RKNAND
	bool "Rockchip NAND FLASH device support"
	depends on BLK
	help
	  This option enables support for Rockchip NAND FLASH devices.
	  It supports block interface(with rk ftl) to read and write NAND FLASH.
```

## drivers/watchdog/Kconfig
```kconfig
config HW_WATCHDOG
	bool "Enable Hardware Watchdog"
	help
	   This config option enables HW WDT support
	   To disable Amlogic's HW WDT, say N

config AMLOGIC_WATCHDOG
	bool "Enable Amlogic SoC HW Watchdog"
	depends on HW_WATCHDOG
	help
	   This config option enables Amlogic's S905 HW watchdog
	   To disable S905 Amlogic's WDT, say N
```

## lib/avb/libavb_user/Kconfig
```kconfig
config AVB_LIBAVB_USER
	bool "Android AVB read/write hardware"
	help
	  This config support the android things system to
	  read/write hardware image, like vbmeta, misc, and
	  so on. And it can provide some a/b and avb information
	  to fastboot and kernel.

config AVB_VBMETA_PUBLIC_KEY_VALIDATE
        bool "Support vbmeta public key validate"
        depends on AVB_LIBAVB_USER
        help
          support vbmeta public key validate.

config SPL_AVB_LIBAVB_USER
	bool "Android AVB read/write hardware for spl"
	help
	  This config support the android things system to
	  read/write hardware image, like vbmeta, misc, and
	  so on. And it can provide some a/b and avb information
	  to fastboot and kernel.

config TPL_AVB_LIBAVB_USER
	bool "Android AVB read/write hardware for tpl"
	help
	  This config support the android things system to
	  read/write hardware image, like vbmeta, misc, and
	  so on. And it can provide some a/b and avb information
	  to fastboot and kernel.
```

## lib/avb/rk_libavb/Kconfig
```kconfig
config AVB_LIBAVB
	bool "Support running U-Boot AVB"
	help
	  The new android bootloader need to startup
	  with a/b and avb.This config can add the
	  AVB functions to u-boot.
```

## lib/avb/rk_libavb_ab/Kconfig
```kconfig
config AVB_LIBAVB_AB
	bool "Choose the a/b system and flow"
	help
	  In the android things system, there are 
	  _a and _b or more systems. So we have to
	  choose the _a or _b system to startup.
	  This libavb_ab can suport these functions.
```

## lib/avb/rk_libavb_atx/Kconfig
```kconfig
config AVB_LIBAVB_ATX
	bool "support vbmeta public key verify"
	help
	  Android Things requires specific public key
	  metadata and verification logic to correctly
	  verify vbmeta public keys.
```

## lib/avb/rk_libavb_user/Kconfig
```kconfig
config AVB_LIBAVB_USER
	bool "Android AVB read/write hardware"
	help
	  This config support the android things system to
	  read/write hardware image, like vbmeta, misc, and 
	  so on. And it can provide some a/b and avb information
	  to fastboot and kernel.
```

## lib/optee_clientApi/Kconfig
```kconfig
config OPTEE_CLIENT
	bool "Support OPTEE"
	help
	  U-boot can communicate with trust if
	  the config is enable. This function can
	  be use in android bootloader a/b and avb
	  step.

config OPTEE_V1
	bool "Support OPTEE version 1.0"
	help
	  U-boot can communicate with trust if
	  the config is enable. This function can
	  be use in android bootloader a/b and avb
	  step.

config OPTEE_V2
	bool "Support OPTEE version 2.0"
	help
	  U-boot can communicate with trust if
	  the config is enable. This function can
	  be use in android bootloader a/b and avb
	  step.

config OPTEE_ALWAYS_USE_SECURITY_PARTITION
	bool "Support use emmc security partition for OPTEE"
	help
	  U-boot can secure store data to security partition
	  for nand or emmc, do not to store data to rpmb.
```
