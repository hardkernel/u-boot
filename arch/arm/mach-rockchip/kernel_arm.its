## arch/arm/mach-rockchip/kernel_arm.its
```
/*
 * Copyright (C) 2020 Fuzhou Rockchip Electronics Co., Ltd
 *
 * Minimal dts for a FIT image.
 *
 * SPDX-License-Identifier: GPL-2.0
 */

/dts-v1/;
/ {
	description = "FIT source file for Linux";
	#address-cells = <1>;

	images {
		fdt {
			data = /incbin/("images/rk-kernel.dtb");
			type = "flat_dt";
			arch = "arm";
			compression = "none";
			load  = <0xffffff00>;
			hash {
				algo = "sha256";
			};
		};

		kernel {
			data = /incbin/("images/kernel.img");
			type = "kernel";
			arch = "arm";
			os = "linux";
			compression = "none";
			entry = <0xffffff01>;
			load  = <0xffffff01>;
			hash {
				algo = "sha256";
			};
		};

		ramdisk {
			data = /incbin/("images/ramdisk.img");
			type = "ramdisk";
			arch = "arm";
			os = "linux";
			compression = "none";
			load  = <0xffffff02>;
			hash {
				algo = "sha256";
			};
		};

		resource {
			data = /incbin/("images/resource.img");
			type = "multi";
			arch = "arm";
			compression = "none";
			hash {
				algo = "sha256";
			};
		};
	};

	configurations {
		default = "conf";
		conf {
			description = "Boot Linux kernel with FDT blob";
			rollback-index = <0x0>;
			fdt = "fdt";
			kernel = "kernel";
			ramdisk = "ramdisk";
			multi = "resource";
			signature {
				algo = "sha256,rsa2048";
				key-name-hint = "dev";
				sign-images = "fdt", "kernel", "ramdisk", "multi";
			};
		};
	};
};
```

## arch/arm/mach-rockchip/kernel_arm64.its
```
/*
 * Copyright (C) 2020 Fuzhou Rockchip Electronics Co., Ltd
 *
 * Minimal dts for a FIT image.
 *
 * SPDX-License-Identifier: GPL-2.0
 */

/dts-v1/;
/ {
	description = "U-Boot FIT source file for arm64";
	#address-cells = <1>;

	images {
		fdt@1 {
			description = "Device tree blob for arm64";
			data = /incbin/("images/rk-kernel.dtb");
			type = "flat_dt";
			arch = "arm64";
			compression = "none";
			load  = <0xffffff00>;
			hash@1 {
				algo = "sha256";
			};
		};

		kernel@1 {
			description = "Kernel for arm64";
			kernel-version = <1>;
			data = /incbin/("images/kernel.img");
			type = "kernel";
			arch = "arm64";
			os = "linux";
			compression = "none";
			entry = <0xffffff01>;
			load  = <0xffffff01>;
			hash@1 {
				algo = "sha256";
			};
		};

		ramdisk@1 {
			description = "Ramdisk for arm64";
			data = /incbin/("images/ramdisk.img");
			type = "ramdisk";
			arch = "arm64";
			os = "linux";
			compression = "none";
			load  = <0xffffff02>;
			hash@1 {
				algo = "sha256";
			};
		};

		resource@1 {
			description = "Resource for arm64";
			data = /incbin/("images/resource.img");
			type = "multi";
			arch = "arm64";
			compression = "none";
			hash@1 {
				algo = "sha256";
			};
		};
	};

	configurations {
		default = "conf@1";
		conf@1 {
			description = "Boot Linux kernel with FDT blob";
			conf-version = <1>;
			fdt = "fdt@1";
			kernel = "kernel@1";
			ramdisk = "ramdisk@1";
			multi = "resource@1";
			signature@1 {
				algo = "sha256,rsa2048";
				key-name-hint = "dev";
				sign-images = "fdt", "kernel", "ramdisk", "multi";
			};
		};
	};
};
```

## arch/arm/mach-rockchip/px30/Kconfig
```kconfig
if ROCKCHIP_PX30

config TARGET_EVB_PX30
	bool "EVB_PX30"
	select BOARD_LATE_INIT

config PLATFORM_ODROID_GOADV
	bool "Support ODROID-GO Advanced Platform"
	select BOARD_LATE_INIT
	help
	   ODROID-GO Advanced configuration

if PLATFORM_ODROID_GOADV
config TARGET_ODROIDGOA
	bool "Target ODROID-GO Advanced"
	help
	   Support all ODROID-GO Advanced boards
endif

config SYS_SOC
	default "rockchip"

config SYS_MALLOC_F_LEN
	default 0x400

config SPL_SERIAL_SUPPORT
	default y

source "board/rockchip/evb_px30/Kconfig"
source "board/rockchip/odroidgoa/Kconfig"

endif
```

## arch/arm/mach-rockchip/rk3588/Kconfig
```kconfig
if ROCKCHIP_RK3588

config TARGET_EVB_RK3588
	bool "EVB_RK3588"
	select BOARD_LATE_INIT
	help
	  RK3588 EVB is a evaluation board for Rockchp RK3588.

config TARGET_ODROID_M2
	bool "ODROID-M2"
	select BOARD_LATE_INIT
	help
	  Hardkernel's ODROID-M2 SBC board for Rockchp RK3588S.

config SYS_SOC
	default "rockchip"

config SYS_MALLOC_F_LEN
	default 0x400

source board/rockchip/evb_rk3588/Kconfig
source board/hardkernel/odroid-m2/Kconfig

endif
```

## arch/arm/mach-rockchip/rv1109/Kconfig
```kconfig
if ROCKCHIP_RV1109

config TARGET_EVB_RV1109
	bool "EVB_RV1109"
	help
	  RV1109 EVB is a evaluation board for Rockchp RV1109.

config SYS_SOC
	default "rockchip"

config SYS_MALLOC_F_LEN
	default 0x400

source board/rockchip/evb_rv1109/Kconfig

endif
```

## board/amlogic/Kconfig
```kconfig
config GXB_SKT_V1
	bool "Support amlogic gxbaby skt v1 board"
	default n

config GXB_P200_V1
	bool "Support amlogic gxbaby p200(develop) v1 board"
	default n

config GXB_P201_V1
	bool "Support amlogic gxbaby p200(reference) v1 board"
	default n

config GXTVBB_SKT_V1
	bool "Support amlogic gxtv baby socket v1 board"
	default n

config GXTVBB_P301_V1
	bool "Support amlogic gxtv baby p301(reference) v1 board"
	default n

config GXTVBB_P300_V1
	bool "Support amlogic gxtv baby p300(develop) v1 board"
	default n

config GXTVBB_P310_V1
	bool "Support amlogic gxtv baby P310 socket v1 board"
	default n

config GXTVBB_P311_V1
	bool "Support amlogic gxtv baby P311 socket v1 board"
	default n

config GXTVBB_9023_SKT_V1
	bool "Support amlogic gxtv baby 9023 socket v1 board"
	default n

config GXTVBB_T966_SKT_V1
	bool "Support amlogic gxtv baby 9023 socket v1 board"
	default n

config GXL_SKT_V1
	bool "Support amlogic gxl socket v1 board"
	default n

config GXL_P212_V1
	bool "Support amlogic gxl p212 board"
	default n

config GXL_P230_V1
	bool "Support amlogic gxm/gxl p230 board"
	default n

config GXL_P231_V1
	bool "Support amlogic gxm/gxl p231 board"
	default n

config GXM_SKT_V1
	bool "Support amlogic gxm/gxl skt board"
	default n

config GXM_Q201_V1
	bool "Support amlogic gxm/gxl q201 board"
	default n

config GXM_Q200_V1
	bool "Support amlogic gxm/gxl q200 board"
	default n

config TXL_SKT_V1
	bool "Support amlogic txl socket v1 board"
	default n

config TXL_P320_V1
	bool "Support amlogic txl p320 board"
	default n

config TXL_P321_V1
	bool "Support amlogic txl p321 board"
	default n

config TXL_P341_V1
	bool "Support amlogic txl t950 p341 board"
	default n

config TXL_P341_V2
	bool "Support amlogic txl t950 p341 v2 board"
	default n

config PXP_EMULATOR
	bool "Support pxp environment"
	default n

config SUPPORT_CUSOTMER_BOARD
	bool "Customer board support"

config ODROID_C2
	bool "Support Hardkernel ODROID-C2 board"
	default n

if GXB_SKT_V1
source "board/amlogic/gxb_skt_v1/Kconfig"
endif

if GXB_P200_V1
source "board/amlogic/gxb_p200_v1/Kconfig"
endif

if GXB_P201_V1
source "board/amlogic/gxb_p201_v1/Kconfig"
endif

if GXTVBB_SKT_V1
source "board/amlogic/gxtvbb_skt_v1/Kconfig"
endif

if GXTVBB_P301_V1
source "board/amlogic/gxtvbb_p301_v1/Kconfig"
endif

if GXTVBB_P300_V1
source "board/amlogic/gxtvbb_p300_v1/Kconfig"
endif

if GXTVBB_P310_V1
source "board/amlogic/gxtvbb_p310_v1/Kconfig"
endif

if GXTVBB_P311_V1
source "board/amlogic/gxtvbb_p311_v1/Kconfig"
endif

if GXTVBB_9023_SKT_V1
source "board/amlogic/gxtvbb_9023_skt_v1/Kconfig"
endif

if GXTVBB_T966_SKT_V1
source "board/amlogic/gxtvbb_t966_skt_v1/Kconfig"
endif

if GXL_SKT_V1
source "board/amlogic/gxl_skt_v1/Kconfig"
endif

if GXL_P212_V1
source "board/amlogic/gxl_p212_v1/Kconfig"
endif

if GXL_P230_V1
source "board/amlogic/gxl_p230_v1/Kconfig"
endif

if GXL_P231_V1
source "board/amlogic/gxl_p231_v1/Kconfig"
endif

if GXM_SKT_V1
source "board/amlogic/gxm_skt_v1/Kconfig"
endif

if GXM_Q201_V1
source "board/amlogic/gxm_q201_v1/Kconfig"
endif

if GXM_Q200_V1
source "board/amlogic/gxm_q200_v1/Kconfig"
endif

if TXL_SKT_V1
source "board/amlogic/txl_skt_v1/Kconfig"
endif

if TXL_P320_V1
source "board/amlogic/txl_p320_v1/Kconfig"
endif

if TXL_P321_V1
source "board/amlogic/txl_p321_v1/Kconfig"
endif

if TXL_P341_V1
source "board/amlogic/txl_p341_v1/Kconfig"
endif

if TXL_P341_V2
source "board/amlogic/txl_p341_v2/Kconfig"
endif

if ODROID_C2
source "board/hardkernel/odroidc2/Kconfig"
endif
```

## board/amlogic/axg_s400_v1_sbr/Kconfig
```kconfig
if TARGET_MESON_AXG

config SYS_CPU
	string
	default "armv8"

config SYS_BOARD
	string
	default "axg_s400_v1_sbr"

config SYS_VENDOR
	string
	default "amlogic"

config SYS_SOC
	string
	default "axg"

config SYS_CONFIG_NAME
	default "axg_s400_v1_sbr"

endif
```

## board/amlogic/defconfigs/axg_pxp_defconfig
```kconfig
CONFIG_ARM=y
CONFIG_TARGET_MESON_AXG=y
CONFIG_AXG_SKT_V1=y
CONFIG_DM=y
CONFIG_DM_GPIO=y
CONFIG_AML_GPIO=y
CONFIG_PXP_EMULATOR=y
```

## board/amlogic/defconfigs/axg_s400_v1_sbr_defconfig
```kconfig
CONFIG_ARM=y
CONFIG_TARGET_MESON_AXG=y
CONFIG_AXG_S400_V1_SBR=y
CONFIG_DM=y
CONFIG_DM_GPIO=y
CONFIG_AML_GPIO=y
```

## board/amlogic/defconfigs/axg_s410_v1_defconfig
```kconfig
CONFIG_ARM=y
CONFIG_TARGET_MESON_AXG=y
CONFIG_AXG_S410_V1=y
CONFIG_DM=y
CONFIG_DM_GPIO=y
CONFIG_AML_GPIO=y
```

## board/amlogic/defconfigs/g12a_pxp_defconfig
```kconfig
CONFIG_ARM=y
CONFIG_TARGET_MESON_g12a=y
CONFIG_g12a_SKT_V1=y
CONFIG_DM=y
CONFIG_DM_GPIO=y
CONFIG_AML_GPIO=y
CONFIG_PXP_EMULATOR=y
```

## board/amlogic/defconfigs/g12a_u200_v1_defconfig
```kconfig
CONFIG_ARM=y
CONFIG_TARGET_MESON_G12A=y
CONFIG_G12A_U200_V1=y
CONFIG_DM=y
CONFIG_DM_GPIO=y
CONFIG_AML_GPIO=y
```

## board/amlogic/defconfigs/g12b_skt_v1_defconfig
```kconfig
CONFIG_ARM=y
CONFIG_TARGET_MESON_G12B=y
CONFIG_G12B_SKT_V1=y
CONFIG_DM=y
CONFIG_DM_GPIO=y
CONFIG_AML_GPIO=y
```

## board/amlogic/defconfigs/g12b_w400_v1_defconfig
```kconfig
CONFIG_ARM=y
CONFIG_TARGET_MESON_G12B=y
CONFIG_G12B_W400_V1=y
CONFIG_DM=y
CONFIG_DM_GPIO=y
CONFIG_AML_GPIO=y
```

## board/amlogic/defconfigs/gxl_p230_v1_defconfig
```kconfig
CONFIG_ARM=y
CONFIG_TARGET_MESON_GX=y
CONFIG_GXL_P230_V1=y
CONFIG_DM=y
CONFIG_DM_GPIO=y
CONFIG_AML_GPIO=y
```

## board/amlogic/defconfigs/gxm_skt_v1_defconfig
```kconfig
CONFIG_ARM=y
CONFIG_TARGET_MESON_GX=y
CONFIG_GXM_SKT_V1=y
CONFIG_DM=y
CONFIG_DM_GPIO=y
CONFIG_AML_GPIO=y
```

## board/amlogic/defconfigs/gxtvbb_9023_skt_v1_defconfig
```kconfig
CONFIG_ARM=y
CONFIG_TARGET_MESON_GXTV=y
CONFIG_GXTVBB_9023_SKT_V1=y
CONFIG_DM=y
CONFIG_DM_GPIO=y
CONFIG_AML_GPIO=y
```

## board/amlogic/defconfigs/sm1_ac200_v1_defconfig
```kconfig
CONFIG_ARM=y
CONFIG_TARGET_MESON_G12A=y
CONFIG_SM1_AC200_V1=y
CONFIG_DM=y
CONFIG_DM_GPIO=y
CONFIG_AML_GPIO=y
```

## board/amlogic/defconfigs/tl1_t309_v1_defconfig
```kconfig
CONFIG_ARM=y
CONFIG_TARGET_MESON_TL1=y
CONFIG_TL1_T309_V1=y
CONFIG_DM=y
CONFIG_DM_GPIO=y
CONFIG_AML_GPIO=y
```

## board/amlogic/defconfigs/tm2_pxp_defconfig
```kconfig
CONFIG_ARM=y
CONFIG_TARGET_MESON_TM2=y
CONFIG_TM2_T962E2_AB319_V1=y
CONFIG_DM=y
CONFIG_DM_GPIO=y
CONFIG_AML_GPIO=y
CONFIG_PXP_EMULATOR=y
```

## board/amlogic/defconfigs/tm2_skt_v1_defconfig
```kconfig
CONFIG_ARM=y
CONFIG_TARGET_MESON_TL1=y
CONFIG_TM2_SKT_V1=y
CONFIG_DM=y
CONFIG_DM_GPIO=y
CONFIG_AML_GPIO=y
```

## board/amlogic/defconfigs/tm2_t962e2_ab311_v1_defconfig
```kconfig
CONFIG_ARM=y
CONFIG_TARGET_MESON_TM2=y
CONFIG_TM2_T962E2_AB311_V1=y
CONFIG_DM=y
CONFIG_DM_GPIO=y
CONFIG_AML_GPIO=y
CONFIG_MTK_BT_USB=y
```

## board/amlogic/defconfigs/tm2_t962x3_ab309_v1_defconfig
```kconfig
CONFIG_ARM=y
CONFIG_TARGET_MESON_TM2=y
CONFIG_TM2_T962X3_AB309_V1=y
CONFIG_DM=y
CONFIG_DM_GPIO=y
CONFIG_AML_GPIO=y
```

## board/amlogic/defconfigs/txl_p321_v1_defconfig
```kconfig
CONFIG_ARM=y
CONFIG_TARGET_MESON_GXTV=y
CONFIG_TXL_P321_V1=y
CONFIG_DM=y
CONFIG_DM_GPIO=y
CONFIG_AML_GPIO=y
```

## board/amlogic/defconfigs/txl_p341_v1_defconfig
```kconfig
CONFIG_ARM=y
CONFIG_TARGET_MESON_TXL=y
CONFIG_TXL_P341_V1=y
CONFIG_DM=y
CONFIG_DM_GPIO=y
CONFIG_AML_GPIO=y
```
