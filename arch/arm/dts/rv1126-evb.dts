// SPDX-License-Identifier: (GPL-2.0+ OR MIT)
/*
 * Copyright (c) 2020 Fuzhou Rockchip Electronics Co., Ltd.
 */

/dts-v1/;
#include "rv1126.dtsi"
#include "rv1126-u-boot.dtsi"

/ {
	model = "Rockchip RV1126 Evaluation Board";
	compatible = "rockchip,rv1126-evb", "rockchip,rv1126";

	ramdisk-ro {
		u-boot,dm-pre-reloc;
		compatible = "ramdisk-ro";
		status = "okay";
	};
};

&uart2 {
	status = "okay";
};

&emmc {
	status = "okay";
};
